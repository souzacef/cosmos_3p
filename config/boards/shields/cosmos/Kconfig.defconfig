## config/boards/shields/cosmos/Kconfig.defconfig
```kconfig
if SHIELD_COSMOS_CENTRAL

config ZMK_KEYBOARD_NAME
	default "Cosmos"

config ZMK_SPLIT_ROLE_CENTRAL
	default y

endif

if SHIELD_COSMOS_CENTRAL || SHIELD_COSMOS_CENTRAL || SHIELD_COSMOS_CENTRAL

config ZMK_SPLIT
	default y
	
endif
```

## config/boards/shields/cosmos_3p/Kconfig.defconfig
```kconfig
if SHIELD_COSMOS_3P_LEFT

config ZMK_KEYBOARD_NAME
    default "Cosmos 3P"

config ZMK_SPLIT_ROLE_PERIPHERAL
    default y

endif

if SHIELD_COSMOS_3P_RIGHT

config ZMK_KEYBOARD_NAME
    default "Cosmos 3P"

config ZMK_SPLIT_ROLE_PERIPHERAL
    default y

endif

if SHIELD_COSMOS_3P_CENTRAL

config ZMK_KEYBOARD_NAME
    default "Cosmos 3P Central"

config ZMK_SPLIT_ROLE_CENTRAL
    default y

config ZMK_USB
    default y

config ZMK_BLE
    default y

endif

if SHIELD_COSMOS_3P_LEFT || SHIELD_COSMOS_3P_RIGHT || SHIELD_COSMOS_3P_CENTRAL

config ZMK_SPLIT
    default y

endif
```

## config/boards/shields/cosmos_3p/Kconfig.shield
```kconfig
config SHIELD_COSMOS_3P_LEFT
    def_bool $(shields_list_contains,cosmos_3p_left)

config SHIELD_COSMOS_3P_RIGHT
    def_bool $(shields_list_contains,cosmos_3p_right)

config SHIELD_COSMOS_3P_CENTRAL
    def_bool $(shields_list_contains,cosmos_3p_central)
```
